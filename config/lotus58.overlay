&i2c1 {
    compatible = "nordic,nrf-twim";
    status = "okay";
    sda-pin = <26>;
    scl-pin = <27>;

    display: display@3c {
        compatible = "ssd1306";
        reg = <0x3C>;
        label = "SSD1306";
        width = <128>;
        height = <32>;
    };
};